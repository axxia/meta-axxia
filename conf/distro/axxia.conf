## conf/distro/axxia.conf
```bitbake
require conf/distro/poky.conf

DISTRO = "axxia"
DISTRO_NAME = "Intel Axxia Distro"
DISTRO_VERSION = "${RELEASE_VERSION}"
DISTRO_CODENAME = "axxia"
SDK_VENDOR = "-axxiasdk"
SDK_VERSION := "${RELEASE_VERSION}"

TARGET_VENDOR = "-axxia"
RELEASE_VERSION ?= "axxia_gen2"

DISTRO_FEATURES_append = " pam virtualization"

include conf/distro/include/axxia-defaults.inc

# Skip bbappends from meta-virtualization to skip fragments 
# and layer specific setings for kernel
BBMASK_append = " meta-virtualization/recipes-kernel/linux"
```

## conf/distro/include/axxia-defaults.inc
```bitbake
YOCTO_ALTERNATIVE_KERNELS ?= "\
${@oe.utils.conditional('PREFERRED_PROVIDER_virtual/kernel',\
	'linux-yocto', '',    ' linux-yocto', d)}\
${@oe.utils.conditional('PREFERRED_PROVIDER_virtual/kernel',\
	'linux-yocto-rt', '', ' linux-yocto-rt', d)}\
${@oe.utils.conditional('PREFERRED_PROVIDER_virtual/kernel',\
	'linux-yocto-debug', '',    ' linux-yocto-debug', d)}\
${@oe.utils.conditional('PREFERRED_PROVIDER_virtual/kernel',\
	'linux-yocto-rt-debug', '', ' linux-yocto-rt-debug', d)}\
"

AXXIA_ALTERNATIVE_KERNELS ?= "\
${@oe.utils.conditional('PREFERRED_PROVIDER_virtual/kernel',\
	'linux-axxia', '',    ' linux-axxia', d)}\
${@oe.utils.conditional('PREFERRED_PROVIDER_virtual/kernel',\
	'linux-axxia-rt', '', ' linux-axxia-rt', d)}\
${@oe.utils.conditional('PREFERRED_PROVIDER_virtual/kernel',\
	'linux-axxia-debug', '',    ' linux-axxia-debug', d)}\
${@oe.utils.conditional('PREFERRED_PROVIDER_virtual/kernel',\
	'linux-axxia-rt-debug', '', ' linux-axxia-rt-debug', d)}\
"

LOCAL_ALTERNATIVE_KERNELS ?= ""

ALTERNATIVE_KERNELS ?= \
"${${@''.join(d.getVar('PREFERRED_PROVIDER_virtual/kernel').upper()\
	.split('-')[1:2])}_ALTERNATIVE_KERNELS}"

ALTERNATIVE_KERNELS_INSTALL ?= \
"${@d.getVar('ALTERNATIVE_KERNELS').replace('linux-','kernel-linux-')}"

ALTERNATIVE_KERNELS_MODULES_INSTALL ?= \
"${@'-modules '.join(d.getVar('ALTERNATIVE_KERNELS_INSTALL')[1:].split(' '))}-modules"

ALTERNATIVE_KERNELS_LTTNG_MODULES ?= \
"${@d.getVar('ALTERNATIVE_KERNELS').replace('linux-','lttng-modules-linux-')}"

PREFERRED_VERSION_linux-yocto ?= "4.19%"
PREFERRED_VERSION_linux-yocto-rt ?= "4.19%"
PREFERRED_VERSION_linux-yocto-debug ?= "4.19%"
PREFERRED_VERSION_linux-yocto-rt-debug ?= "4.19%"
PREFERRED_VERSION_linux-axxia ?= "4.19%"
PREFERRED_VERSION_linux-axxia-rt ?= "4.19%"
PREFERRED_VERSION_linux-axxia-debug ?= "4.19%"
PREFERRED_VERSION_linux-axxia-rt-debug ?= "4.19%"

PREFERRED_RPROVIDER_iasl ?= "iasl"
PREFERRED_RPROVIDER_iasl-native ?= "iasl-native"
PREFERRED_VERSION_rpcbind ?= "0.2.3"

FORTRAN_forcevariable = ",fortran"
```

## conf/machine/axxiaarm.conf
```bitbake
#@TYPE: Machine
#@NAME: axxiaarm
#@DESCRIPTION: Machine configuration for INTEL Axxia ARM systems

PREFERRED_PROVIDER_virtual/kernel ?= "linux-axxia-rt"
PREFERRED_VERSION_linux-axxia-rt ?= "5.10%"

MACHINE_FEATURES += "ext3"

# Default tune will be for 5500 board: cortexa17 (armv7a)
CHIPSET ?= "5500"
TUNE_X9 = "conf/machine/include/tune-cortexa57-axxia.inc"
TUNE_XLF = "conf/machine/include/tune-cortexa53-axxia.inc"
TUNE_5500 = "conf/machine/include/tune-cortexa15.inc"
require ${TUNE_${CHIPSET}}

# Armv8a SoCs supports 32-bit and 64-bit states.
# Set default to 32-bit state for axxiarm machine
DEFAULTTUNE_X9 = "cortexa57_32-crypto"
DEFAULTTUNE_XLF = "cortexa53_32-crypto"
DEFAULTTUNE_5500 = "cortexa15-neon"
DEFAULTTUNE = "${DEFAULTTUNE_${CHIPSET}}"

KARCH = "arm"
KERNEL_IMAGETYPE = "zImage"
UBOOT_ENTRYPOINT = "0x400000"
KEEPUIMAGE = "no"

IMAGE_FSTYPES += "ext2"
IMAGE_FSTYPES += "tar.gz"

SERIAL_CONSOLES = "9600;ttyAMA0"
```

## conf/machine/axxiaarm64.conf
```bitbake
#@TYPE: Machine
#@NAME: axxiaarm64
#@DESCRIPTION: Machine configuration for INTEL Axxia ARM64 systems

PREFERRED_PROVIDER_virtual/kernel ?= "linux-axxia-rt"
PREFERRED_VERSION_linux-axxia-rt ?= "5.4%"

MACHINE_FEATURES += "ext3"

# Default tune will be for X9 board: cortexa57
CHIPSET ?= "X9"
TUNE_X9 = "conf/machine/include/tune-cortexa57-axxia.inc"
TUNE_XLF = "conf/machine/include/tune-cortexa53-axxia.inc"
require ${TUNE_${CHIPSET}}

# Armv8a SoCs supports 32-bit and 64-bit states.
# Set default to 64-bit state for axxiarm64 machine
DEFAULTTUNE_X9 = "cortexa57_64-crypto"
DEFAULTTUNE_XLF = "cortexa53_64-crypto"
DEFAULTTUNE = "${DEFAULTTUNE_${CHIPSET}}"

KARCH = "arm64"
KERNEL_IMAGETYPE = "Image"
UBOOT_ENTRYPOINT = "0x400000"
KEEPUIMAGE = "no"

IMAGE_FSTYPES += "ext2"
IMAGE_FSTYPES += "tar.gz"

SERIAL_CONSOLES = "9600;ttyAMA0"
```

## recipes-kernel/linux/conf/axxia-4.19/axxiaarm64/X9/standard/defconfig
```kconfig
# CONFIG_LOCALVERSION_AUTO is not set
CONFIG_SYSVIPC=y
CONFIG_POSIX_MQUEUE=y
CONFIG_AUDIT=y
CONFIG_NO_HZ_IDLE=y
CONFIG_HIGH_RES_TIMERS=y
CONFIG_PREEMPT=y
CONFIG_BSD_PROCESS_ACCT=y
CONFIG_BSD_PROCESS_ACCT_V3=y
CONFIG_TASKSTATS=y
CONFIG_TASK_DELAY_ACCT=y
CONFIG_TASK_XACCT=y
CONFIG_TASK_IO_ACCOUNTING=y
CONFIG_IKCONFIG=y
CONFIG_IKCONFIG_PROC=y
CONFIG_LOG_BUF_SHIFT=14
CONFIG_MEMCG=y
CONFIG_MEMCG_SWAP=y
CONFIG_CGROUP_HUGETLB=y
CONFIG_CPUSETS=y
CONFIG_CGROUP_DEVICE=y
CONFIG_CGROUP_CPUACCT=y
CONFIG_NAMESPACES=y
CONFIG_USER_NS=y
CONFIG_CHECKPOINT_RESTORE=y
CONFIG_SCHED_AUTOGROUP=y
CONFIG_BLK_DEV_INITRD=y
CONFIG_EXPERT=y
CONFIG_SYSCTL_SYSCALL=y
CONFIG_KALLSYMS_ALL=y
# CONFIG_COMPAT_BRK is not set
CONFIG_PROFILING=y
CONFIG_ARCH_AXXIA=y
CONFIG_ARCH_THUNDER=y
CONFIG_ARCH_VEXPRESS=y
CONFIG_ARCH_XGENE=y
CONFIG_PCI=y
CONFIG_RAPIDIO=y
CONFIG_AXXIA_RIO=y
CONFIG_RIO_MAINT_WIN_SIZE=0x1000000
CONFIG_AXXIA_RIO_STAT=y
CONFIG_RAPIDIO_ENABLE_RX_TX_PORTS=y
CONFIG_RAPIDIO_DEBUG=y
CONFIG_RAPIDIO_ENUM_BASIC=y
CONFIG_RAPIDIO_CPS_XX=y
CONFIG_RAPIDIO_CPS_GEN2=y
CONFIG_KEXEC=y
CONFIG_CMDLINE="console=ttyAMA0"
CONFIG_COMPAT=y
CONFIG_VIRTUALIZATION=y
CONFIG_KVM=y
CONFIG_ARM64_CRYPTO=y
CONFIG_CRYPTO_SHA1_ARM64_CE=y
CONFIG_CRYPTO_SHA2_ARM64_CE=y
CONFIG_CRYPTO_GHASH_ARM64_CE=y
CONFIG_CRYPTO_AES_ARM64_CE_CCM=y
CONFIG_CRYPTO_AES_ARM64_CE_BLK=y
CONFIG_CRYPTO_AES_ARM64_NEON_BLK=y
CONFIG_JUMP_LABEL=y
CONFIG_MODULES=y
CONFIG_MODULE_UNLOAD=y
# CONFIG_BLK_DEV_BSG is not set
# CONFIG_IOSCHED_DEADLINE is not set
# CONFIG_CORE_DUMP_DEFAULT_ELF_HEADERS is not set
CONFIG_KSM=y
CONFIG_TRANSPARENT_HUGEPAGE=y
CONFIG_CMA=y
CONFIG_NET=y
CONFIG_PACKET=y
CONFIG_PACKET_DIAG=y
CONFIG_UNIX=y
CONFIG_UNIX_DIAG=y
CONFIG_INET=y
CONFIG_IP_PNP=y
CONFIG_IP_PNP_DHCP=y
CONFIG_IP_PNP_BOOTP=y
CONFIG_INET_UDP_DIAG=y
CONFIG_NETFILTER=y
CONFIG_NF_CONNTRACK=y
CONFIG_NETFILTER_XT_TARGET_CHECKSUM=y
CONFIG_NETFILTER_XT_MATCH_STATE=y
CONFIG_IP_NF_IPTABLES=y
CONFIG_IP_NF_FILTER=y
CONFIG_IP_NF_NAT=y
CONFIG_IP_NF_TARGET_MASQUERADE=y
CONFIG_IP_NF_MANGLE=y
CONFIG_IP6_NF_IPTABLES=y
CONFIG_IP6_NF_MANGLE=y
CONFIG_IP6_NF_NAT=y
CONFIG_IP6_NF_TARGET_MASQUERADE=y
CONFIG_BRIDGE=y
CONFIG_VLAN_8021Q=y
CONFIG_NETLINK_DIAG=y
CONFIG_BPF_JIT=y
# CONFIG_WIRELESS is not set
CONFIG_NET_9P=y
CONFIG_NET_9P_VIRTIO=y
CONFIG_UEVENT_HELPER_PATH="/sbin/hotplug"
CONFIG_DEVTMPFS=y
CONFIG_DEVTMPFS_MOUNT=y
CONFIG_DMA_CMA=y
CONFIG_MTD=y
CONFIG_MTD_M25P80=y
CONFIG_MTD_SPI_NOR=y
CONFIG_BLK_DEV_LOOP=y
CONFIG_BLK_DEV_RAM=y
CONFIG_BLK_DEV_RAM_SIZE=35000
CONFIG_VIRTIO_BLK=y
CONFIG_AXXIA_MTC=y
CONFIG_AXXIA_NCR=y
CONFIG_ARCH_AXXIA_NCR_RESET_CHECK=y
CONFIG_AXXIA_OEM=y
CONFIG_AXXIA_FAULT=y
CONFIG_AXXIA_PEI=y
# CONFIG_SCSI_PROC_FS is not set
CONFIG_BLK_DEV_SD=y
# CONFIG_SCSI_LOWLEVEL is not set
CONFIG_ATA=y
CONFIG_SATA_AHCI=y
CONFIG_SATA_AHCI_PLATFORM=y
CONFIG_AHCI_XGENE=y
CONFIG_PATA_PLATFORM=y
CONFIG_PATA_OF_PLATFORM=y
CONFIG_NETDEVICES=y
CONFIG_MACVLAN=y
CONFIG_RIONET=y
CONFIG_TUN=y
CONFIG_VETH=y
CONFIG_VIRTIO_NET=y
CONFIG_NET_XGENE=y
CONFIG_SMC91X=y
CONFIG_SMSC911X=y
CONFIG_MICREL_PHY=y
CONFIG_MICREL_KS8995MA=y
# CONFIG_WLAN is not set
CONFIG_INPUT_EVDEV=y
# CONFIG_SERIO_SERPORT is not set
CONFIG_SERIO_AMBAKMI=y
CONFIG_LEGACY_PTY_COUNT=16
CONFIG_SERIAL_8250=y
CONFIG_SERIAL_8250_CONSOLE=y
CONFIG_SERIAL_OF_PLATFORM=y
CONFIG_SERIAL_AMBA_PL011=y
CONFIG_SERIAL_AMBA_PL011_CONSOLE=y
CONFIG_VIRTIO_CONSOLE=y
CONFIG_HW_RANDOM=y
CONFIG_HW_RANDOM_AXXIA=y
# CONFIG_HW_RANDOM_XGENE is not set
CONFIG_I2C=y
CONFIG_I2C_CHARDEV=y
CONFIG_I2C_MUX=y
CONFIG_SPI=y
CONFIG_SPI_PL022=y
CONFIG_SPI_SPIDEV=y
CONFIG_GPIO_SYSFS=y
CONFIG_GPIO_AXXIA=y
CONFIG_GPIO_XGENE=y
CONFIG_POWER_RESET_AXXIA=y
CONFIG_POWER_RESET_AXXIA_DDR_RETENTION=y
# CONFIG_HWMON is not set
CONFIG_REGULATOR=y
CONFIG_REGULATOR_FIXED_VOLTAGE=y
CONFIG_FB=y
CONFIG_FB_ARMCLCD=y
CONFIG_FRAMEBUFFER_CONSOLE=y
CONFIG_LOGO=y
# CONFIG_LOGO_LINUX_MONO is not set
# CONFIG_LOGO_LINUX_VGA16 is not set
CONFIG_USB=y
CONFIG_USB_XHCI_HCD=y
CONFIG_USB_STORAGE=y
CONFIG_USB_DWC3=y
CONFIG_USB_ULPI=y
CONFIG_MMC=y
CONFIG_MMC_ARMMMCI=y
CONFIG_MMC_SDHCI=y
CONFIG_MMC_SDHCI_PLTFM=y
CONFIG_MMC_SPI=y
CONFIG_EDAC=y
CONFIG_EDAC_AXXIA_SYSMEM_5600=y
CONFIG_EDAC_AXXIA_L3_5600=y
CONFIG_EDAC_AXXIA_SYSMEM_SKIP_CORRECTABLE=y
CONFIG_EDAC_AXXIA_CMEM_5600=y
CONFIG_EDAC_AXXIA_CMEM_SKIP_CORRECTABLE=y
CONFIG_EDAC_AXXIA_L2_CPU_5600=y
CONFIG_RTC_CLASS=y
CONFIG_RTC_DRV_EFI=y
CONFIG_RTC_DRV_XGENE=y
CONFIG_DMADEVICES=y
CONFIG_VIRTIO_BALLOON=y
CONFIG_VIRTIO_MMIO=y
# CONFIG_IOMMU_SUPPORT is not set
CONFIG_PHY_XGENE=y
CONFIG_EXT2_FS=y
CONFIG_EXT3_FS=y
CONFIG_FANOTIFY=y
CONFIG_FANOTIFY_ACCESS_PERMISSIONS=y
CONFIG_AUTOFS4_FS=y
CONFIG_FUSE_FS=y
CONFIG_CUSE=y
CONFIG_VFAT_FS=y
CONFIG_TMPFS=y
CONFIG_HUGETLBFS=y
CONFIG_SQUASHFS=y
CONFIG_SQUASHFS_XATTR=y
CONFIG_SQUASHFS_LZO=y
CONFIG_SQUASHFS_XZ=y
CONFIG_SQUASHFS_4K_DEVBLK_SIZE=y
CONFIG_SQUASHFS_EMBEDDED=y
CONFIG_NFS_FS=y
CONFIG_ROOT_NFS=y
CONFIG_NFSD=y
CONFIG_9P_FS=y
CONFIG_NLS_CODEPAGE_437=y
CONFIG_NLS_ISO8859_1=y
CONFIG_VMFS_IRQ=0
CONFIG_SECURITY=y
CONFIG_CRYPTO_ANSI_CPRNG=y
CONFIG_DEBUG_INFO=y
# CONFIG_SCHED_DEBUG is not set
CONFIG_IRQSOFF_TRACER=y
CONFIG_SCHED_TRACER=y
CONFIG_STACK_TRACER=y
CONFIG_FUNCTION_PROFILER=y
```
